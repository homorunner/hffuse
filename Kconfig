## Kconfig
```kconfig
# SPDX-License-Identifier: GPL-2.0-only
config HFFUSE_FS
	tristate "HFFUSE (Filesystem in Userspace) support"
	select FS_POSIX_ACL
	select FS_IOMAP
	help
	  With HFFUSE it is possible to implement a fully functional filesystem
	  in a userspace program.

	  There's also a companion library: libhffuse2.  This library is available
	  from the HFFUSE homepage:
	  <https://github.com/libhffuse/>
	  although chances are your distribution already has that library
	  installed if you've installed the "hffuse" package itself.

	  See <file:Documentation/filesystems/hffuse.rst> for more information.
	  See <file:Documentation/Changes> for needed library/utility version.

	  If you want to develop a userspace FS, or if you want to use
	  a filesystem based on HFFUSE, answer Y or M.

config CUSE
	tristate "Character device in Userspace support"
	depends on HFFUSE_FS
	help
	  This HFFUSE extension allows character devices to be
	  implemented in userspace.

	  If you want to develop or use a userspace character device
	  based on CUSE, answer Y or M.

config VIRTIO_FS
	tristate "Virtio Filesystem"
	depends on HFFUSE_FS
	select VIRTIO
	help
	  The Virtio Filesystem allows guests to mount file systems from the
	  host.

	  If you want to share files between guests or with the host, answer Y
	  or M.

config HFFUSE_DAX
	bool "Virtio Filesystem Direct Host Memory Access support"
	default y
	select INTERVAL_TREE
	depends on VIRTIO_FS
	depends on FS_DAX
	depends on DAX
	help
	  This allows bypassing guest page cache and allows mapping host page
	  cache directly in guest address space.

	  If you want to allow mounting a Virtio Filesystem with the "dax"
	  option, answer Y.

config HFFUSE_PASSTHROUGH
	bool "HFFUSE passthrough operations support"
	default y
	depends on HFFUSE_FS
	select FS_STACK
	help
	  This allows bypassing HFFUSE server by mapping specific HFFUSE operations
	  to be performed directly on a backing file.

	  If you want to allow passthrough operations, answer Y.

config HFFUSE_IO_URING
	bool "HFFUSE communication over io-uring"
	default y
	depends on HFFUSE_FS
	depends on IO_URING
	help
	  This allows sending HFFUSE requests over the io-uring interface and
          also adds request core affinity.

	  If you want to allow hffuse server/client communication through io-uring,
	  answer Y
```
